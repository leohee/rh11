#include "Math2.h"

extern void delay5ms(unsigned char n);
extern void delay5us(unsigned char n);


/* CRC 高位字节值表 */ 
static unsigned char code auchCRCHi[256] = { 
	0x00, 0xC1, 0x81, 0x40, 0x01, 0xC0, 0x80, 0x41, 0x01, 0xC0, 
	0x80, 0x41, 0x00, 0xC1, 0x81, 0x40, 0x01, 0xC0, 0x80, 0x41, 
	0x00, 0xC1, 0x81, 0x40, 0x00, 0xC1, 0x81, 0x40, 0x01, 0xC0, 
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	0x80, 0x41, 0x00, 0xC1, 0x81, 0x40 
}; 
	
/* CRC低位字节值表*/ 
static char code auchCRCLo[256] = { 
	0x00, 0xC0, 0xC1, 0x01, 0xC3, 0x03, 0x02, 0xC2, 0xC6, 0x06, 
	0x07, 0xC7, 0x05, 0xC5, 0xC4, 0x04, 0xCC, 0x0C, 0x0D, 0xCD, 
	0x0F, 0xCF, 0xCE, 0x0E, 0x0A, 0xCA, 0xCB, 0x0B, 0xC9, 0x09, 
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	0x43, 0x83, 0x41, 0x81, 0x80, 0x40 
}; 


unsigned short CRC16(unsigned puchMsg, unsigned int usDataLen) 
{ 
	unsigned char uchCRCHi = 0xFF ; /* 高CRC字节初始化 */ 
	unsigned char uchCRCLo = 0xFF ; /* 低CRC 字节初始化 */ 
	unsigned uIndex ; /* CRC循环中的索引 */ 

	while (usDataLen--) { /* 传输消息缓冲区 */ 
		uIndex = uchCRCHi ^ *puchMsg++ ; /* 计算CRC */ 
		uchCRCHi = uchCRCLo ^ auchCRCHi[uIndex] ; 
		uchCRCLo = auchCRCLo[uIndex] ; 
	} 
	return (uchCRCHi << 8 | uchCRCLo) ;
}

void Initial_UART (void)
{
    //SCON    Bit:    7        6     5        4    3        2    1    0
    //        SM0/FE        SM1    SM2        REN    TB8    RB8      TI    RI
    SCON=0x50;        //0101,0000  8位可变baud,无奇偶效验
    PCON=0;

    if (baud==0) {
        TH1=BAUD2400;
        TL1=BAUD2400;
    }

    if (baud==1) {
        TH1=BAUD4800;
        TL1=BAUD4800;
    }

    if (baud==2) {
        TH1=BAUD9600;
        TL1=BAUD9600;
    }

    if (baud==3) {
        TH1=BAUD9600;
        TL1=BAUD9600;
        PCON=0x80;        //BUD 加倍
    }

    AUXR&=0xbf;        //定时器工作在I2T模式
    TR1=1;            //启动定时器1
    ES=1;
    EA=1;
}


void UART_Interrupt(void)interrupt 4 
{
	uint i = 0;

	if (0 == RI) {
		return ;
	}

	data_buf=SBUF;
	RI=0;
	TI=0;

	count_rcv_time=0;
	uart_rx_flag=1;
	uart_count=0;

	switch(rxd_lengh) {
	case 0:
		if (data_buf==slave_addres) {    //判断第一个字节是否与本机地址相等
			rcv_buf[0]=data_buf;
			rxd_lengh=1;
		} else {
			goto rest_out;
		}
	break;

    case 1:   
		if (data_buf==4) {    //判断第二个数据是否为4功能码
			rcv_buf[1]=data_buf;
			rxd_lengh=2;
		} else {
			goto rest_out;
		}
	break;

    case 2: 
		if (data_buf==0) {        //第三个数据＝00H？不等，就退出
			rcv_buf[2]=data_buf;
			rxd_lengh=3;
		} else {
			goto rest_out;
		}
	break;

	case 3: 
		rcv_buf[rxd_lengh]=data_buf;        // 保存SBUF到rcv_buf[rxd_lengh]位置
		rxd_lengh=4;                         // 数据长度＋1
	break;

	case 4: 
		rcv_buf[rxd_lengh]=data_buf; 
		rxd_lengh=5;  
	break;

	case 5: 
		rcv_buf[rxd_lengh]=data_buf; 
		rxd_lengh=6;  
	break;

	case 6: 
		rcv_buf[rxd_lengh]=data_buf; 
		rxd_lengh=7;  
	break;

	case 7: 
		rcv_buf[rxd_lengh]=data_buf; 
		goto    uart_rec_over; 
	break;

	default: 
		goto rest_out; 
	break;
	}

	return;

rest_out:
     
    rxd_lengh=0;   
    ES=1; 
    RI=0;
	TI=0; 

    return;

deal_error:
    ES=0;
    txd_buff[0]=slave_addres;
    txd_buff[1]=0x04;
    txd_buff[2]=0x04;
    txd_buff[3]=temp_buf>>8;
    txd_buff[4]=temp_buf;
    txd_buff[5]=humi_buf>>8;
    txd_buff[6]=humi_buf&0x0ff;
    crc_value=CRC16(txd_buff, 7);
    txd_buff[7]=crc_value>>8;
    txd_buff[8]=crc_value&0xff;
    txd_lengh=9;

    DE=0;                    //置位DE
    while(DE) {
		DE=0;
	};
    delay5ms(4);
    for (i=0;i<txd_lengh;i++) {
        SBUF=txd_buff[i];
        while(!TI);
        TI=0;
	}
    rxd_lengh=0;
    RI=0;
	TI=0; 
    ES=1;
    DE=1;
    return;

uart_rec_over:
    if (sensor_error >= 4) {
		goto deal_error;
	}
    ES=0;                   // 关“串口0”中断    
    uart_tx_flag=1;
    
    crc_value=CRC16(rcv_buf, 6);        //crc
    if (crc_value!=(rcv_buf[6] << 8 | rcv_buf[7])) {
        goto rest_out;
	}

    if (rcv_buf[1]!=4)        //检验功能码
        goto rest_out;

    if (rcv_buf[2]!=0)        //判数据地址高位
        goto rest_out;

    if (rcv_buf[3]>2)        //判数据地址低位,数据地址是否<=2?
        goto rest_out; 

    if (rcv_buf[4]!=0)        //判数据长度高位
        goto rest_out;

    if (rcv_buf[5]>2)        //判数据长度低位,数据长度<=2 ?
        goto rest_out; 

    txd_buff[0]=slave_addres;    //发送从机地址
    txd_buff[1]=0x04;            //发送从机功能码
    txd_buff[2]=rcv_buf[5]*2;    //发送数据字节LENGH
    
    txd_lengh=9;

    if (temp_buf<0) {
        txd_buff[3]=((0-temp_buf)>>8)|0x80;
        txd_buff[4]=(0-temp_buf)&0x0ff;
	} else {
        txd_buff[3]=temp_buf>>8;
        txd_buff[4]=temp_buf&0x0ff;
	}

    txd_buff[5]=humi_buf>>8;
    txd_buff[6]=humi_buf&0x0ff;

    crc_value=CRC16(txd_buff, 7);
    txd_buff[7]=crc_value>>8;        //crc值
    txd_buff[8]=crc_value&0xff;

    
    DE=0;                    //置位DE
    while(DE) {DE=0;};
    delay5ms(4);
    for (i=0;i<txd_lengh;i++) {
        SBUF=txd_buff[i];
        while(!TI);
        TI=0;
	}

    rxd_lengh=0;
    RI=0;
	TI=0; 
    ES=1;
    DE=1;
}


